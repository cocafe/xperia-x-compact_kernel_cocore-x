## crypto/fips/kscl/Kconfig
```kconfig
config CRYPTO_SOMC_FIPS_KSCL
	tristate "Sony Mobile Communications FIPS AES-XTS/AES-CBC Driver"
	help
```

## drivers/crypto/kscl/Kconfig
```kconfig
config CRYPTO_DEV_SOMC_KSCL
	tristate "Sony Mobile Communications FIPS AES-XTS/AES-CBC Driver"
	help
```

## drivers/platform/Kconfig
```kconfig
if X86
source "drivers/platform/x86/Kconfig"
endif
if GOLDFISH
source "drivers/platform/goldfish/Kconfig"
endif

if ARCH_MSM
source "drivers/platform/msm/Kconfig"
endif

source "drivers/platform/broadcom/v4l2-driver/Kconfig"
source "drivers/platform/broadcom/wlan/bcm4359/bcmdhd/Kconfig"
```

## drivers/platform/broadcom/v4l2-driver/bt_protocol_driver/Kconfig
```kconfig
config BROADCOM_V4L2_BT_DRV
	tristate "broadcom v4l2 BT protocol driver"
	select BROADCOM_V4L2_HCI_LDISC
	default m
	help
	  Enable broadcom v4l2 BT protocol driver supports
```

## drivers/platform/broadcom/v4l2-driver/line_discipline_driver/Kconfig
```kconfig
config BROADCOM_V4L2_HCI_LDISC
	tristate "broadcom v4l2 hci ldisc driver"
	default m
	help
	  Enable broadcom v4l2 hci ldisc driver supports
```

## drivers/platform/broadcom/v4l2-driver/v4l2_ant_driver/Kconfig
```kconfig
config BROADCOM_V4L2_ANT_DRV
	tristate "broadcom v4l2 ant driver"
	select BROADCOM_V4L2_HCI_LDISC
	default m
	help
	  Enable broadcom v4l2 ant driver supports
```
